## br_secure/br2-ext/Config.in
```kconfig
source "$BR2_EXTERNAL_SECURE_OS_ADDITIONS_PATH/minijail/Config.in"
source "$BR2_EXTERNAL_SECURE_OS_ADDITIONS_PATH/alfred/Config.in"
source "$BR2_EXTERNAL_SECURE_OS_ADDITIONS_PATH/libiw-hp/Config.in"
source "$BR2_EXTERNAL_SECURE_OS_ADDITIONS_PATH/bmx7/Config.in"
source "$BR2_EXTERNAL_SECURE_OS_ADDITIONS_PATH/softhsm2/Config.in"
source "$BR2_EXTERNAL_SECURE_OS_ADDITIONS_PATH/opensc/Config.in"
```

## br_secure/br2-ext/alfred/Config.in
```kconfig
config BR2_PACKAGE_ALFRED
	bool "alfred"
	select BR2_PACKAGE_GPSD
	help
	  Alfred is a user space daemon for distributing
	  arbitrary local information over the mesh/network in
	  a decentralized fashion.
	  This data can be anything which appears to be useful
	  - originally designed to replace the batman-adv visualization (vis),
	  you may distribute hostnames, phone books,
	  administration information,
	  DNS information, the local weather forecast ...

	  https://www.open-mesh.org/projects/alfred/wiki
```

## br_secure/br2-ext/bmx7/Config.in
```kconfig
config BR2_PACKAGE_BMX7
	bool "bmx7"
	select BR2_PACKAGE_LIBIW_HP
	select BR2_PACKAGE_ZLIB
	select BR2_PACKAGE_LIBZLIB
	select BR2_PACKAGE_MBEDTLS
	help
		BMX7 is a mesh routing protocol for Linux based operating systems.

		https://github.com/bmx-routing/bmx7
```

## br_secure/br2-ext/libiw-hp/Config.in
```kconfig
config BR2_PACKAGE_LIBIW_HP
	bool "libiw_hp"
	help
		Wireless Tools for Linux

		https://github.com/HewlettPackard/wireless-tools
```

## br_secure/br2-ext/minijail/Config.in
```kconfig
config BR2_PACKAGE_MINIJAIL
	bool "minijail"
	depends on BR2_PACKAGE_LIBCAP
	help
	  Minijail is a sandboxing tool maintained by google.

	  https://google.github.io/minijail/
```

## br_secure/br2-ext/opensc/Config.in
```kconfig
config BR2_PACKAGE_OPENSC
	bool "opensc"
	depends on BR2_PACKAGE_LIBOPENSSL && BR2_PACKAGE_PCSC_LITE
	help
		OpenSC provides a set of libraries and utilities to work with smart cards.

		https://github.com/OpenSC/OpenSC.git
```

## br_secure/br2-ext/softhsm2/Config.in
```kconfig
config BR2_PACKAGE_SOFTHSM2
	bool "softhsm2"
	depends on BR2_PACKAGE_LIBOPENSSL
	select BR2_PACKAGE_LIBTOOL
	help
		SoftHSM is an implementation of a cryptographic store accessible through a PKCS\#11 interface. You can use it to explore PKCS\#11 without having a Hardware Security Module.

		https://github.com/opendnssec/SoftHSMv2
```
