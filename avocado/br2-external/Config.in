## avocado/br2-external/Config.in
```kconfig
source "$BR2_EXTERNAL_AVOCADO_PATH/avocado/Config.in"
source "$BR2_EXTERNAL_AVOCADO_PATH/avocado-vt/Config.in"
source "$BR2_EXTERNAL_AVOCADO_PATH/aexpect/Config.in"
```

## avocado/br2-external/aexpect/Config.in
```kconfig
config BR2_PACKAGE_AEXPECT
	bool "aexpect"
	help
	  Aexpect is a dependency for avocado-vt.
```

## br_admin/br2-ext/Config.in
```kconfig
source "$BR2_EXTERNAL_ADMIN_VM_ADDITIONS_PATH/avocado/Config.in"
source "$BR2_EXTERNAL_ADMIN_VM_ADDITIONS_PATH/avocado-vt/Config.in"
source "$BR2_EXTERNAL_ADMIN_VM_ADDITIONS_PATH/aexpect/Config.in"
```

## br_admin/br2-ext/avocado-vt/Config.in
```kconfig
config BR2_PACKAGE_AVOCADO_VT
	bool "avocado-vt"
	help
	  Avocado VT is a virtualization test plugin for avocado test
	  framework.

	  https://avocado-vt.readthedocs.io/
```

## br_admin/br2-ext/avocado/Config.in
```kconfig
config BR2_PACKAGE_AVOCADO
	bool "avocado"
	help
	  Avocado is an automated testing suite containing tests for various
	  subsystems.

	  https://avocado-framework.readthedocs.io/
```
