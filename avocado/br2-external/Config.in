## br_admin/x86_qemu_kvm_release_defconfig
```kconfig
# CONFIG_LOCALVERSION_AUTO is not set
CONFIG_SYSVIPC=y
CONFIG_POSIX_MQUEUE=y
CONFIG_AUDIT=y
CONFIG_NO_HZ=y
CONFIG_HIGH_RES_TIMERS=y
CONFIG_PREEMPT_VOLUNTARY=y
CONFIG_BSD_PROCESS_ACCT=y
CONFIG_TASKSTATS=y
CONFIG_TASK_DELAY_ACCT=y
CONFIG_TASK_XACCT=y
CONFIG_TASK_IO_ACCOUNTING=y
CONFIG_LOG_BUF_SHIFT=18
CONFIG_CGROUP_SCHED=y
CONFIG_CGROUP_FREEZER=y
CONFIG_CPUSETS=y
CONFIG_CGROUP_CPUACCT=y
CONFIG_BLK_DEV_INITRD=y
# CONFIG_COMPAT_BRK is not set
CONFIG_PROFILING=y
CONFIG_SMP=y
CONFIG_X86_REROUTE_FOR_BROKEN_BOOT_IRQS=y
CONFIG_MICROCODE_AMD=y
CONFIG_X86_MSR=y
CONFIG_X86_CPUID=y
CONFIG_NUMA=y
CONFIG_X86_CHECK_BIOS_CORRUPTION=y
# CONFIG_MTRR_SANITIZER is not set
CONFIG_EFI=y
CONFIG_EFI_STUB=y
CONFIG_EFI_MIXED=y
CONFIG_HZ_1000=y
CONFIG_KEXEC=y
CONFIG_CRASH_DUMP=y
CONFIG_HIBERNATION=y
CONFIG_PM_DEBUG=y
CONFIG_PM_TRACE_RTC=y
CONFIG_ACPI_DOCK=y
CONFIG_ACPI_BGRT=y
CONFIG_CPU_FREQ_DEFAULT_GOV_USERSPACE=y
CONFIG_CPU_FREQ_GOV_ONDEMAND=y
CONFIG_X86_ACPI_CPUFREQ=y
CONFIG_IA32_EMULATION=y
CONFIG_EFI_VARS=y
CONFIG_KPROBES=y
CONFIG_JUMP_LABEL=y
CONFIG_MODULES=y
CONFIG_MODULE_UNLOAD=y
CONFIG_MODULE_FORCE_UNLOAD=y
# CONFIG_UNUSED_SYMBOLS is not set
CONFIG_BINFMT_MISC=y
CONFIG_PACKET=y
CONFIG_UNIX=y
CONFIG_XFRM_USER=y
CONFIG_IP_MULTICAST=y
CONFIG_IP_ADVANCED_ROUTER=y
CONFIG_IP_MULTIPLE_TABLES=y
CONFIG_IP_ROUTE_MULTIPATH=y
CONFIG_IP_ROUTE_VERBOSE=y
CONFIG_IP_PNP_BOOTP=y
CONFIG_IP_PNP_RARP=y
CONFIG_IP_MROUTE=y
CONFIG_IP_PIMSM_V1=y
CONFIG_IP_PIMSM_V2=y
CONFIG_SYN_COOKIES=y
# CONFIG_INET_DIAG is not set
CONFIG_TCP_CONG_ADVANCED=y
# CONFIG_TCP_CONG_BIC is not set
# CONFIG_TCP_CONG_WESTWOOD is not set
# CONFIG_TCP_CONG_HTCP is not set
CONFIG_TCP_MD5SIG=y
CONFIG_INET6_AH=y
CONFIG_INET6_ESP=y
CONFIG_NETLABEL=y
CONFIG_NETFILTER=y
# CONFIG_NETFILTER_ADVANCED is not set
CONFIG_NF_CONNTRACK=y
CONFIG_NF_CONNTRACK_FTP=y
CONFIG_NF_CONNTRACK_IRC=y
CONFIG_NF_CONNTRACK_SIP=y
CONFIG_NF_CT_NETLINK=y
CONFIG_NF_NAT=y
CONFIG_NETFILTER_XT_TARGET_CONNSECMARK=y
CONFIG_NETFILTER_XT_TARGET_NFLOG=y
CONFIG_NETFILTER_XT_TARGET_SECMARK=y
CONFIG_NETFILTER_XT_TARGET_TCPMSS=y
CONFIG_NETFILTER_XT_MATCH_CONNTRACK=y
CONFIG_NETFILTER_XT_MATCH_POLICY=y
CONFIG_NETFILTER_XT_MATCH_STATE=y
CONFIG_IP_NF_IPTABLES=y
CONFIG_IP_NF_FILTER=y
CONFIG_IP_NF_TARGET_REJECT=y
CONFIG_IP_NF_TARGET_MASQUERADE=m
CONFIG_IP_NF_MANGLE=y
CONFIG_IP6_NF_IPTABLES=y
CONFIG_IP6_NF_MATCH_IPV6HEADER=y
CONFIG_IP6_NF_FILTER=y
CONFIG_IP6_NF_TARGET_REJECT=y
CONFIG_IP6_NF_MANGLE=y
CONFIG_NET_SCHED=y
CONFIG_NET_EMATCH=y
CONFIG_NET_CLS_ACT=y
CONFIG_CFG80211=y
CONFIG_MAC80211=y
CONFIG_MAC80211_LEDS=y
CONFIG_RFKILL=y
CONFIG_PCIEPORTBUS=y
CONFIG_PCCARD=y
CONFIG_YENTA=y
CONFIG_DEVTMPFS=y
CONFIG_DEVTMPFS_MOUNT=y
CONFIG_DEBUG_DEVRES=y
CONFIG_CONNECTOR=y
CONFIG_BLK_DEV_LOOP=y
CONFIG_BLK_DEV_SD=y
CONFIG_CHR_DEV_SG=y
CONFIG_SCSI_CONSTANTS=y
CONFIG_SCSI_SPI_ATTRS=y
CONFIG_ATA=y
CONFIG_SATA_AHCI=y
CONFIG_ATA_PIIX=y
CONFIG_PATA_AMD=y
CONFIG_PATA_OLDPIIX=y
CONFIG_PATA_SCH=y
CONFIG_BLK_DEV_MD=y
CONFIG_BLK_DEV_DM=y
CONFIG_DM_MIRROR=y
CONFIG_DM_ZERO=y
CONFIG_MACINTOSH_DRIVERS=y
CONFIG_MAC_EMUMOUSEBTN=y
CONFIG_NETCONSOLE=y
CONFIG_TIGON3=y
CONFIG_NET_TULIP=y
CONFIG_E100=y
CONFIG_E1000=y
CONFIG_E1000E=y
CONFIG_SKY2=y
CONFIG_FORCEDETH=y
CONFIG_8139TOO=y
CONFIG_R8169=y
CONFIG_INPUT_POLLDEV=y
CONFIG_INPUT_TABLET=y
# CONFIG_LEGACY_PTYS is not set
CONFIG_SERIAL_8250_NR_UARTS=32
CONFIG_SERIAL_8250_EXTENDED=y
CONFIG_SERIAL_8250_MANY_PORTS=y
CONFIG_SERIAL_8250_SHARE_IRQ=y
CONFIG_SERIAL_8250_DETECT_IRQ=y
CONFIG_SERIAL_8250_RSA=y
CONFIG_SERIAL_NONSTANDARD=y
CONFIG_HW_RANDOM=y
# CONFIG_HW_RANDOM_INTEL is not set
# CONFIG_HW_RANDOM_AMD is not set
CONFIG_NVRAM=y
# CONFIG_HPET_MMAP is not set
CONFIG_I2C_I801=y
CONFIG_WATCHDOG=y
CONFIG_AGP=y
CONFIG_AGP_AMD64=y
CONFIG_AGP_INTEL=y
CONFIG_DRM=y
CONFIG_DRM_I915=y
CONFIG_FB_MODE_HELPERS=y
CONFIG_FB_TILEBLITTING=y
CONFIG_FB_EFI=y
CONFIG_LOGO=y
# CONFIG_LOGO_LINUX_MONO is not set
# CONFIG_LOGO_LINUX_VGA16 is not set
CONFIG_SOUND=y
CONFIG_SND=y
CONFIG_SND_HDA_INTEL=y
CONFIG_SND_HDA_HWDEP=y
CONFIG_HIDRAW=y
CONFIG_LOGITECH_FF=y
CONFIG_HID_NTRIG=y
CONFIG_PANTHERLORD_FF=y
CONFIG_HID_SONY=y
CONFIG_USB_HIDDEV=y
CONFIG_USB=y
CONFIG_USB_ANNOUNCE_NEW_DEVICES=y
CONFIG_USB_MON=y
CONFIG_USB_XHCI_HCD=y
CONFIG_USB_EHCI_HCD=y
CONFIG_USB_OHCI_HCD=y
CONFIG_USB_UHCI_HCD=y
CONFIG_USB_STORAGE=y
CONFIG_RTC_CLASS=y
# CONFIG_RTC_HCTOSYS is not set
CONFIG_DMADEVICES=y
CONFIG_EEEPC_LAPTOP=y
CONFIG_AMD_IOMMU=y
CONFIG_INTEL_IOMMU=y
# CONFIG_INTEL_IOMMU_DEFAULT_ON is not set
CONFIG_EXT4_FS=y
CONFIG_EXT4_FS_POSIX_ACL=y
CONFIG_EXT4_FS_SECURITY=y
CONFIG_QUOTA=y
CONFIG_QUOTA_NETLINK_INTERFACE=y
# CONFIG_PRINT_QUOTA_WARNING is not set
CONFIG_QFMT_V2=y
CONFIG_AUTOFS4_FS=y
CONFIG_MSDOS_FS=y
CONFIG_VFAT_FS=y
CONFIG_PROC_KCORE=y
CONFIG_TMPFS_POSIX_ACL=y
CONFIG_HUGETLBFS=y
CONFIG_NFS_FS=y
CONFIG_NFS_V3_ACL=y
CONFIG_NFS_V4=y
CONFIG_ROOT_NFS=y
CONFIG_NLS_DEFAULT="utf8"
CONFIG_NLS_CODEPAGE_437=y
CONFIG_NLS_ASCII=y
CONFIG_NLS_ISO8859_1=y
CONFIG_NLS_UTF8=y
CONFIG_SECURITY=y
CONFIG_SECURITY_NETWORK=y
CONFIG_SECURITY_SELINUX=y
CONFIG_SECURITY_SELINUX_BOOTPARAM=y
CONFIG_SECURITY_SELINUX_DISABLE=y
CONFIG_PRINTK_TIME=y
CONFIG_MAGIC_SYSRQ=y
CONFIG_DEBUG_STACK_USAGE=y
# CONFIG_SCHED_DEBUG is not set
CONFIG_SCHEDSTATS=y
CONFIG_BLK_DEV_IO_TRACE=y
CONFIG_PROVIDE_OHCI1394_DMA_INIT=y
CONFIG_EARLY_PRINTK_DBGP=y
CONFIG_DEBUG_BOOT_PARAMS=y
# Disable remote control devices (IR, RF, video capture adapters etc.)
CONFIG_RC_CORE=n

# Disable USB media drivers (video/audio)
CONFIG_MEDIA_USB_SUPPORT=n

# Disable TV decoder/tuner support
CONFIG_MEDIA_DIGITAL_TV_SUPPORT=n
CONFIG_MEDIA_ANALOG_TV_SUPPORT=n

# Disable any unnecessary media drivers (TV, radio, IR etc.)
CONFIG_MEDIA_SUPPORT_FILTER=y

# Disable CDROM support
CONFIG_CDROM=n
CONFIG_BLK_DEV_SR=n
CONFIG_CDROM_PKTCDVD=n

# Disable number of net vendor drivers
CONFIG_NET_VENDOR_3COM=n
CONFIG_NET_VENDOR_ADAPTEC=n
CONFIG_NET_VENDOR_AGERE=n
CONFIG_NET_VENDOR_ALACRITECH=n
CONFIG_NET_VENDOR_ALTEON=n
CONFIG_NET_VENDOR_AMAZON=n
CONFIG_NET_VENDOR_AMD=n
CONFIG_NET_VENDOR_AQUANTIA=n
CONFIG_NET_VENDOR_ARC=n
CONFIG_NET_VENDOR_ATHEROS=n
CONFIG_NET_VENDOR_AURORA=n
# CONFIG_NET_VENDOR_BROADCOM=n
CONFIG_NET_VENDOR_BROCADE=n
CONFIG_NET_VENDOR_CADENCE=n
CONFIG_NET_VENDOR_CAVIUM=n
CONFIG_NET_VENDOR_CHELSIO=n
CONFIG_NET_VENDOR_CISCO=n
CONFIG_NET_VENDOR_CORTINA=n
CONFIG_NET_VENDOR_DEC=n
CONFIG_NET_VENDOR_DLINK=n
CONFIG_NET_VENDOR_EMULEX=n
CONFIG_NET_VENDOR_EZCHIP=n
CONFIG_NET_VENDOR_FUJITSU=n
CONFIG_NET_VENDOR_GOOGLE=n
CONFIG_NET_VENDOR_HISILICON=n
CONFIG_NET_VENDOR_HUAWEI=n
CONFIG_NET_VENDOR_I825XX=n
CONFIG_NET_VENDOR_MARVELL=n
CONFIG_NET_VENDOR_MELLANOX=n
CONFIG_NET_VENDOR_MICREL=n
CONFIG_NET_VENDOR_MICROCHIP=n
CONFIG_NET_VENDOR_MICROSEMI=n
CONFIG_NET_VENDOR_MYRI=n
CONFIG_NET_VENDOR_NATSEMI=n
CONFIG_NET_VENDOR_NETERION=n
CONFIG_NET_VENDOR_NETRONOME=n
CONFIG_NET_VENDOR_NI=n
CONFIG_NET_VENDOR_8390=n
CONFIG_NET_VENDOR_NVIDIA=n
CONFIG_NET_VENDOR_OKI=n
CONFIG_NET_VENDOR_PACKET_ENGINES=n
CONFIG_NET_VENDOR_PENSANDO=n
CONFIG_NET_VENDOR_QLOGIC=n
CONFIG_NET_VENDOR_QUALCOMM=n
CONFIG_NET_VENDOR_RDC=n
CONFIG_NET_VENDOR_REALTEK=n
CONFIG_NET_VENDOR_RENESAS=n
CONFIG_NET_VENDOR_ROCKER=n
CONFIG_NET_VENDOR_SAMSUNG=n
CONFIG_NET_VENDOR_SEEQ=n
CONFIG_NET_VENDOR_SOLARFLARE=n
CONFIG_NET_VENDOR_SILAN=n
CONFIG_NET_VENDOR_SIS=n
CONFIG_NET_VENDOR_SMSC=n
CONFIG_NET_VENDOR_SOCIONEXT=n
CONFIG_NET_VENDOR_STMICRO=n
CONFIG_NET_VENDOR_SUN=n
CONFIG_NET_VENDOR_SYNOPSYS=n
CONFIG_NET_VENDOR_TEHUTI=n
CONFIG_NET_VENDOR_TI=n
CONFIG_NET_VENDOR_VIA=n
CONFIG_NET_VENDOR_WIZNET=n
CONFIG_NET_VENDOR_XILINX=n
CONFIG_NET_VENDOR_XIRCOM=n

# Disable a number of WLAN vendor drivers
CONFIG_WLAN_VENDOR_ADMTEK=n
CONFIG_WLAN_VENDOR_ATH=n
CONFIG_WLAN_VENDOR_ATMEL=n
# CONFIG_WLAN_VENDOR_BROADCOM=n
CONFIG_WLAN_VENDOR_CISCO=n
CONFIG_WLAN_VENDOR_INTEL=n
CONFIG_WLAN_VENDOR_INTERSIL=n
CONFIG_WLAN_VENDOR_MARVELL=n
CONFIG_WLAN_VENDOR_MEDIATEK=n
CONFIG_WLAN_VENDOR_MICROCHIP=n
CONFIG_WLAN_VENDOR_RALINK=n
CONFIG_WLAN_VENDOR_REALTEK=n
CONFIG_WLAN_VENDOR_RSI=n
CONFIG_WLAN_VENDOR_ST=n
CONFIG_WLAN_VENDOR_TI=n
CONFIG_WLAN_VENDOR_ZYDAS=n
CONFIG_WLAN_VENDOR_QUANTENNA=n

# We don't need USB networking drivers as we have real ethernet
CONFIG_USB_NET_RNDIS_WLAN=n
CONFIG_USB_NET_DRIVERS=n

# Disable file systems we most likely don't care about
CONFIG_OCFS2_FS=n
CONFIG_BTRFS_FS=n
CONFIG_REISERFS_FS=n
CONFIG_JFS_FS=n
CONFIG_XFS_FS=n
CONFIG_GFS2_FS=n
CONFIG_NTFS_FS=n
CONFIG_ISO9660_FS=n
CONFIG_JOLIET=n
CONFIG_ZISOFS=n
CONFIG_UDF_FS=n
CONFIG_NILFS2_FS=n
CONFIG_F2FS_FS=n

# Disable RTC drivers
CONFIG_RTC_DRV_ABX80X=n
CONFIG_RTC_DRV_DS1307=n
CONFIG_RTC_DRV_DS1374=n
CONFIG_RTC_DRV_DS1672=n
CONFIG_RTC_DRV_MAX6900=n
CONFIG_RTC_DRV_RS5C372=n
CONFIG_RTC_DRV_ISL1208=n
CONFIG_RTC_DRV_ISL12022=n
CONFIG_RTC_DRV_X1205=n
CONFIG_RTC_DRV_PCF8523=n
CONFIG_RTC_DRV_PCF85363=n
CONFIG_RTC_DRV_PCF8563=n
CONFIG_RTC_DRV_PCF8583=n
CONFIG_RTC_DRV_M41T80=n
CONFIG_RTC_DRV_BQ32K=n
CONFIG_RTC_DRV_S35390A=n
CONFIG_RTC_DRV_FM3130=n
CONFIG_RTC_DRV_RX8581=n
CONFIG_RTC_DRV_RX8025=n
CONFIG_RTC_DRV_EM3027=n
CONFIG_RTC_DRV_RV3028=n
CONFIG_RTC_DRV_SD3078=n
CONFIG_RTC_DRV_M41T93=n
CONFIG_RTC_DRV_M41T94=n
CONFIG_RTC_DRV_DS1302=n
CONFIG_RTC_DRV_DS1305=n
CONFIG_RTC_DRV_DS1390=n
CONFIG_RTC_DRV_R9701=n
CONFIG_RTC_DRV_RX4581=n
CONFIG_RTC_DRV_RS5C348=n
CONFIG_RTC_DRV_MAX6902=n
CONFIG_RTC_DRV_PCF2123=n
CONFIG_RTC_DRV_DS3232=n
CONFIG_RTC_DRV_DS3232_HWMON=n
CONFIG_RTC_DRV_PCF2127=n
CONFIG_RTC_DRV_RV3029C2=n
CONFIG_RTC_DRV_RV3029_HWMON=n

# Disable unnecessary USB drivers
CONFIG_USB_SERIAL=n
CONFIG_USB_CONFIGFS=n
CONFIG_USB_PRINTER=n
CONFIG_USB_CONFIGFS=n
CONFIG_USB_AUDIO=n
CONFIG_USB_GADGET=n
CONFIG_USB_UAS=n
CONFIG_USB_MDC800=n
CONFIG_USB_MICROTEK=n
CONFIG_USBIP_CORE=n
CONFIG_USBIP_VHCI_HCD=n
CONFIG_USBIP_HOST=n
CONFIG_USB_DWC2=n
CONFIG_USB_DWC2_HOST=n
CONFIG_USB_EMI62=n
CONFIG_USB_EMI26=n
CONFIG_USB_ADUTUX=n
CONFIG_USB_SEVSEG=n
CONFIG_USB_LEGOTOWER=n
CONFIG_USB_LCD=n
CONFIG_USB_CYPRESS_CY7C63=n
CONFIG_USB_CYTHERM=n
CONFIG_USB_IDMOUSE=n
CONFIG_USB_FTDI_ELAN=n
CONFIG_USB_APPLEDISPLAY=n
CONFIG_USB_LD=n
CONFIG_USB_TRANCEVIBRATOR=n
CONFIG_USB_IOWARRIOR=n
CONFIG_USB_TEST=n
CONFIG_USB_ISIGHTFW=n
CONFIG_USB_YUREX=n
CONFIG_USB_ATM=n
CONFIG_USB_SPEEDTOUCH=n
CONFIG_USB_CXACRU=n
CONFIG_USB_UEAGLEATM=n
CONFIG_USB_XUSBATM=n
CONFIG_SND_USB=n
CONFIG_USB_HID=n

# HID devices
CONFIG_I2C_HID=n
CONFIG_HID_BATTERY_STRENGTH=n
CONFIG_HID_GENERIC=n
CONFIG_HID_A4TECH=n
CONFIG_HID_ACRUX=n
CONFIG_HID_APPLE=n
CONFIG_HID_BELKIN=n
CONFIG_HID_CHERRY=n
CONFIG_HID_CHICONY=n
CONFIG_HID_CYPRESS=n
CONFIG_HID_DRAGONRISE=n
CONFIG_HID_EMS_FF=n
CONFIG_HID_ELECOM=n
CONFIG_HID_EZKEY=n
CONFIG_HID_GEMBIRD=n
CONFIG_HID_KEYTOUCH=n
CONFIG_HID_KYE=n
CONFIG_HID_WALTOP=n
CONFIG_HID_GYRATION=n
CONFIG_HID_TWINHAN=n
CONFIG_HID_KENSINGTON=n
CONFIG_HID_LCPOWER=n
CONFIG_HID_MAGICMOUSE=n
CONFIG_HID_MICROSOFT=n
CONFIG_HID_MONTEREY=n
CONFIG_HID_MULTITOUCH=n
CONFIG_HID_ORTEK=n
CONFIG_HID_PANTHERLORD=n
CONFIG_HID_PETALYNX=n
CONFIG_HID_PICOLCD=n
CONFIG_HID_SAMSUNG=n
CONFIG_HID_SPEEDLINK=n
CONFIG_HID_STEAM=n
CONFIG_HID_SUNPLUS=n
CONFIG_HID_GREENASIA=n
CONFIG_HID_SMARTJOYPLUS=n
CONFIG_HID_TOPSEED=n
CONFIG_HID_THRUSTMASTER=n
CONFIG_HID_XINMO=n
CONFIG_HID_ZEROPLUS=n
CONFIG_HID_ZYDACRON=n
CONFIG_HID_PID=n

# Input devices
CONFIG_RFKILL_INPUT=n
CONFIG_INPUT_FF_MEMLESS=n
CONFIG_INPUT_MATRIXKMAP=n
CONFIG_INPUT_MOUSEDEV=n
CONFIG_INPUT_JOYDEV=n
CONFIG_INPUT_EVDEV=n
CONFIG_INPUT_KEYBOARD=n
CONFIG_INPUT_JOYSTICK=n
CONFIG_INPUT_TOUCHSCREEN=n
CONFIG_INPUT_MISC=n
CONFIG_INPUT_AD714X=n
CONFIG_INPUT_AD714X_I2C=n
CONFIG_INPUT_AD714X_SPI=n
CONFIG_INPUT_ATI_REMOTE2=n
CONFIG_INPUT_KEYSPAN_REMOTE=n
CONFIG_INPUT_POWERMATE=n
CONFIG_INPUT_YEALINK=n
CONFIG_INPUT_CM109=n
CONFIG_INPUT_UINPUT=n
CONFIG_INPUT_GPIO_ROTARY_ENCODER=n
CONFIG_INPUT_ADXL34X=n
CONFIG_INPUT_ADXL34X_I2C=n
CONFIG_INPUT_ADXL34X_SPI=n
CONFIG_INPUT_CMA3000=n
CONFIG_SND_JACK_INPUT_DEV=n

# Gameport
CONFIG_GAMEPORT=n

# Sound devices
CONFIG_SND_RAWMIDI=n
CONFIG_SND_COMPRESS_OFFLOAD=n
CONFIG_SND_JACK=n
CONFIG_SND_JACK_INPUT_DEV=n
CONFIG_SND_OSSEMUL=n
CONFIG_SND_PCM_OSS=n
CONFIG_SND_PCM_OSS_PLUGINS=n
CONFIG_SND_PCM_TIMER=n
CONFIG_SND_HRTIMER=n
CONFIG_SND_SUPPORT_OLD_API=n
CONFIG_SND_PROC_FS=n
CONFIG_SND_VERBOSE_PROCFS=n
CONFIG_SND_SEQUENCER=n
CONFIG_SND_SEQ_DUMMY=n
CONFIG_SND_SEQ_HRTIMER_DEFAULT=n
CONFIG_SND_SEQ_MIDI_EVENT=n
CONFIG_SND_SEQ_MIDI=n
CONFIG_SND_SEQ_VIRMIDI=n
CONFIG_SND_MPU401_UART=n
CONFIG_SND_DRIVERS=n
CONFIG_SND_DUMMY=n
CONFIG_SND_ALOOP=n
CONFIG_SND_VIRMIDI=n
CONFIG_SND_MTPAV=n
CONFIG_SND_SERIAL_U16550=n
CONFIG_SND_MPU401=n
CONFIG_SND_PCI=n
CONFIG_SND_SPI=n
CONFIG_SND_SOC_GENERIC_DMAENGINE_PCM=n
CONFIG_SND_SOC_COMPRESS=n
CONFIG_SND_BCM2835_SOC_I2S=n
CONFIG_SND_BCM2708_SOC_GOOGLEVOICEHAT_SOUNDCARD=n
CONFIG_SND_BCM2708_SOC_HIFIBERRY_DAC=n
CONFIG_SND_BCM2708_SOC_HIFIBERRY_DACPLUS=n
CONFIG_SND_BCM2708_SOC_HIFIBERRY_DACPLUSHD=n
CONFIG_SND_BCM2708_SOC_HIFIBERRY_DACPLUSADC=n
CONFIG_SND_BCM2708_SOC_HIFIBERRY_DACPLUSADCPRO=n
CONFIG_SND_BCM2708_SOC_HIFIBERRY_DACPLUSDSP=n
CONFIG_SND_BCM2708_SOC_HIFIBERRY_DIGI=n
CONFIG_SND_BCM2708_SOC_HIFIBERRY_AMP=n
CONFIG_SND_BCM2708_SOC_PIFI_40=n
CONFIG_SND_BCM2708_SOC_RPI_CIRRUS=n
CONFIG_SND_BCM2708_SOC_RPI_DAC=n
CONFIG_SND_BCM2708_SOC_RPI_PROTO=n
CONFIG_SND_BCM2708_SOC_JUSTBOOM_BOTH=n
CONFIG_SND_BCM2708_SOC_JUSTBOOM_DAC=n
CONFIG_SND_BCM2708_SOC_JUSTBOOM_DIGI=n
CONFIG_SND_BCM2708_SOC_IQAUDIO_CODEC=n
CONFIG_SND_BCM2708_SOC_IQAUDIO_DAC=n
CONFIG_SND_BCM2708_SOC_IQAUDIO_DIGI=n
CONFIG_SND_BCM2708_SOC_I_SABRE_Q2M=n
CONFIG_SND_BCM2708_SOC_ADAU1977_ADC=n
CONFIG_SND_AUDIOINJECTOR_PI_SOUNDCARD=n
CONFIG_SND_AUDIOINJECTOR_OCTO_SOUNDCARD=n
CONFIG_SND_AUDIOINJECTOR_ISOLATED_SOUNDCARD=n
CONFIG_SND_AUDIOSENSE_PI=n
CONFIG_SND_DIGIDAC1_SOUNDCARD=n
CONFIG_SND_BCM2708_SOC_DIONAUDIO_LOCO=n
CONFIG_SND_BCM2708_SOC_DIONAUDIO_LOCO_V2=n
CONFIG_SND_BCM2708_SOC_ALLO_PIANO_DAC=n
CONFIG_SND_BCM2708_SOC_ALLO_PIANO_DAC_PLUS=n
CONFIG_SND_BCM2708_SOC_ALLO_BOSS_DAC=n
CONFIG_SND_BCM2708_SOC_ALLO_DIGIONE=n
CONFIG_SND_BCM2708_SOC_ALLO_KATANA_DAC=n
CONFIG_SND_BCM2708_SOC_FE_PI_AUDIO=n
CONFIG_SND_PISOUND=n
# CONFIG_SND_RPI_SIMPLE_SOUNDCARD=n
# CONFIG_SND_RPI_WM8804_SOUNDCARD=n
CONFIG_SND_SOC_I2C_AND_SPI=n
CONFIG_SND_SOC_ARIZONA=n
CONFIG_SND_SOC_WM_ADSP=n
CONFIG_SND_SOC_AD193X=n
CONFIG_SND_SOC_AD193X_SPI=n
CONFIG_SND_SOC_AD193X_I2C=n
CONFIG_SND_SOC_ADAU1701=n
CONFIG_SND_SOC_ADAU1977=n
CONFIG_SND_SOC_ADAU1977_I2C=n
CONFIG_SND_SOC_ADAU7002=n
CONFIG_SND_SOC_AK4554=n
CONFIG_SND_SOC_CS4265=n
CONFIG_SND_SOC_CS4271=n
CONFIG_SND_SOC_CS4271_I2C=n
CONFIG_SND_SOC_CS42XX8=n
CONFIG_SND_SOC_CS42XX8_I2C=n
CONFIG_SND_SOC_DA7213=n
CONFIG_SND_SOC_DMIC=n
CONFIG_SND_SOC_ICS43432=n
CONFIG_SND_SOC_MA120X0P=n
CONFIG_SND_SOC_MAX98357A=n
CONFIG_SND_SOC_PCM179X=n
CONFIG_SND_SOC_PCM179X_I2C=n
CONFIG_SND_SOC_PCM186X=n
CONFIG_SND_SOC_PCM186X_I2C=n
CONFIG_SND_SOC_PCM5102A=n
CONFIG_SND_SOC_PCM512x=n
CONFIG_SND_SOC_PCM512x_I2C=n
CONFIG_SND_SOC_PCM1794A=n
CONFIG_SND_SOC_SGTL5000=n
CONFIG_SND_SOC_SIGMADSP=n
CONFIG_SND_SOC_SIGMADSP_I2C=n
CONFIG_SND_SOC_SPDIF=n
CONFIG_SND_SOC_TAS571X=n
CONFIG_SND_SOC_TAS5713=n
CONFIG_SND_SOC_TLV320AIC32X4=n
CONFIG_SND_SOC_TLV320AIC32X4_I2C=n
CONFIG_SND_SOC_WM5102=n
CONFIG_SND_SOC_WM8731=n
CONFIG_SND_SOC_WM8741=n
CONFIG_SND_SOC_WM8804=n
CONFIG_SND_SOC_WM8804_I2C=n
CONFIG_SND_SOC_TPA6130A2=n
CONFIG_SND_SOC_I_SABRE_CODEC=n
CONFIG_SND_SIMPLE_CARD_UTILS=n
CONFIG_SND_SIMPLE_CARD=n
CONFIG_SND_AUDIO_GRAPH_CARD=n
# CONFIG_SND_BCM2835=n

# RAID support
CONFIG_MD=n
CONFIG_RAID6_PQ=n
# Enable kernel config in image and proc (if used)

# Enable on demand CPU throttling
CONFIG_CPU_FREQ_DEFAULT_GOV_ONDEMAND=y

CONFIG_MULTIUSER=y
CONFIG_KVM=y
CONFIG_HIGH_RES_TIMER=y
CONFIG_HPET=y
CONFIG_COMPACTION=y
CONFIG_MIGRATION=y
CONFIG_TRANSPARENT_HUGEPAGE=y
CONFIG_CGROUPS=y
COMFIG_KSM=y
CONFIG_HW_PERF_EVENTS=y
CONFIG_KVM_ARM_PMU=y
CONFIG_TUN=y
CONFIG_VHOST_NET=y
# Enable kernel config in image and proc (if used)
CONFIG_IKCONFIG=y
CONFIG_IKCONFIG_PROC=y

# From default kvm_guest.config
CONFIG_NET=y
CONFIG_NET_CORE=y
CONFIG_NETDEVICES=y
CONFIG_BLOCK=y
CONFIG_BLK_DEV=y
CONFIG_NETWORK_FILESYSTEMS=y
CONFIG_INET=y
CONFIG_TTY=y
CONFIG_SERIAL_8250=y
CONFIG_SERIAL_8250_CONSOLE=y
CONFIG_IP_PNP=y
CONFIG_IP_PNP_DHCP=y
CONFIG_BINFMT_ELF=y
CONFIG_PCI=y
CONFIG_PCI_MSI=y
CONFIG_DEBUG_KERNEL=y
CONFIG_VIRTUALIZATION=y
CONFIG_HYPERVISOR_GUEST=y
CONFIG_PARAVIRT=y
CONFIG_KVM_GUEST=y
CONFIG_S390_GUEST=y
CONFIG_VIRTIO=y
CONFIG_VIRTIO_MENU=y
CONFIG_VIRTIO_PCI=y
CONFIG_VIRTIO_BLK=y
CONFIG_VIRTIO_CONSOLE=y
CONFIG_VIRTIO_NET=y
CONFIG_9P_FS=y
CONFIG_NET_9P=y
CONFIG_NET_9P_VIRTIO=y
CONFIG_SCSI_LOWLEVEL=y
CONFIG_SCSI_VIRTIO=y
CONFIG_VIRTIO_INPUT=y
CONFIG_DRM_VIRTIO_GPU=y

# This was needed for the virtio-disk to work
CONFIG_VIRTIO_MMIO=y

CONFIG_VIRTIO_RING=y
CONFIG_VIRTIO_BALLOON=y
CONFIG_HW_RANDOM_VIRTIO=y
CONFIG_PARAVIRT_GUEST=y
CONFIG_KVM_CLOCK=y
CONFIG_ACPIHP=y
CONFIG_HOTPLUG_PCI=y
CONFIG_PCI_HOST_GENERIC=y
CONFIG_KVM_INTEL=y
CONFIG_NET_VENDOR_INTEL=y

# Bridge support is needed for avocado-vt support
CONFIG_BRIDGE=y
# Vsock communication options
# Host kernel:
CONFIG_EVENTFD=y
CONFIG_VSOCKETS=y
CONFIG_VSOCKETS_DIAG=y
CONFIG_VHOST_VSOCK=y
CONFIG_VHOST=y
```
